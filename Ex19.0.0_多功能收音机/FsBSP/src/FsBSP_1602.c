/* ****************************** 作者：残弈悟恩 *****************************************
 * 文件名称 : FsBSP_1602.c
 * 文件描述 : 1602液晶的驱动程序
 * 硬件平台 ：飛天三號 FSST15实验板
 * 软件环境 ：Keil uVision5.13
 * 
 * 版本代号	: V1.0 	   					
 * 修改日期	: 2015-08-30
 * 技术论坛 ：电子工程师基地（http://www.ieebase.net）
 * 淘宝店铺 ：http://fsmcu.taobao.com
 * 例程说明 ：本例程为教材《与STC15单片机牵手的那些年》（清华大学出版社）配套例程
			  为视频《深入浅出玩转STC15单片机》配套例程（录制100讲--西安：愚公）
			  视频和书籍均被STC（深圳宏晶科技）官方大学计划和高校高性能联合实验室权威推荐

 * Copyright (C), 2013-2015, 兰州文轩电子科技有限公司/清华大学出版社
 
 * 仅供学习使用，未经作者许可，不得用于其它商业用途，盗版必究。
************************************************************************************** */

#include "FsBSP_1602.h"

/* ***************************************************** */
// 函数名称：DectectBusyBit()
// 函数功能：液晶遇忙检测
// 入口参数：无
// 出口参数：无
/* ***************************************************** */
void DectectBusyBit(void)
{   
	DB = 0xff;				// 读状态值时，先赋高电平 
	RS = 0;
	RW = 1;					// 从液晶读数据
	EN = 1;
	Delay_ms(1);
	while(DB & 0x80);		// 若LCD忙，停止到这里，否则走起
	EN = 0;					// 之后将EN初始化为低电平 
}
/* ***************************************************** */
// 函数名称：WrComLCD()
// 函数功能：向液晶写命令
// 入口参数：命令(ComVal)
// 出口参数：无
/* ***************************************************** */
void WrComLCD(u8 ComVal)
{
	DectectBusyBit();
	RS = 0;
	RW = 0;
	EN = 1;
	DB = ComVal;
	Delay_ms(1);
	EN = 0;	
}
/* ***************************************************** */
// 函数名称：WrDatLCD()
// 函数功能：向液晶写数据
// 入口参数：数据(DatVal)
// 出口参数：无
/* ***************************************************** */
void WrDatLCD(u8 DatVal)
{
		DectectBusyBit();
		RS = 1;
		RW = 0;
		EN = 1;	
		DB = DatVal;
		Delay_ms(1);
		EN = 0;	
}
/* ***************************************************** */
// 函数名称：LcdSetCursor(u8 x, u8 y)
// 函数功能：设置显示起始地址
// 入口参数：u8 x, u8 y，即光标的坐标位置
// 出口参数：无
/* ***************************************************** */
void LcdSetCursor(u8 x, u8 y)
{
	u8 addr;
	if(y == 0)
		addr = 0x00 + x;
	else
		addr = 0x40 + x;
	WrComLCD(addr | 0x80);
	Delay_ms(1);
}
/* ***************************************************** */
// 函数名称：LcdShowStr(u8 x, u8 y, u8 *str)
// 函数功能：设置字符串的显示
// 入口参数：u8 x, u8 y（即光标的坐标位置）u8 *str是字符串指针
// 出口参数：无
/* ***************************************************** */
void LcdShowStr(u8 x, u8 y, u8 *str)
{
	LcdSetCursor(x, y);
	while(*str != '\0')
	{
		WrDatLCD(*str++); 
		Delay_ms(1);
	}
}
/* ***************************************************** */
// 函数名称：LCD_Init()
// 函数功能：液晶初始化
// 入口参数：无
// 出口参数：无
/* ***************************************************** */
void LCD_Init(void)
{ 
		WrComLCD(0x38);		// 16*2行显示、5*7点阵、8位数据接口
		Delay_ms(5);  		// 稍作延时
		WrComLCD(0x38);    	// 重新设置一遍
		WrComLCD(0x01);    	// 显示清屏 
		WrComLCD(0x06);    	// 光标自增、画面不动  
		Delay_ms(5);			// 稍作延时
		WrComLCD(0x0C);    	// 开显示、关光标并不闪烁
}

/* *********************************** End of File *********************************** */