/* ****************************** 作者：残弈悟恩 *****************************************
 * 文件名称 : FsBSP_1602.c
 * 文件描述 : 1602液晶的驱动程序
 * 硬件平台 ：飛天三號 FSST15实验板
 * 软件环境 ：Keil uVision5.13
 * 
 * 版本代号	: V1.0 	   					
 * 修改日期	: 2015-08-30
 * 技术论坛 ：电子工程师基地（http://www.ieebase.net）
 * 淘宝店铺 ：http://fsmcu.taobao.com
 * 例程说明 ：本例程为教材《与STC15单片机牵手的那些年》（清华大学出版社）配套例程
			  为视频《深入浅出玩转STC15单片机》配套例程（录制100讲--西安：愚公）
			  视频和书籍均被STC（深圳宏晶科技）官方大学计划和高校高性能联合实验室权威推荐

 * Copyright (C), 2013-2015, 兰州文轩电子科技有限公司/清华大学出版社
 
 * 仅供学习使用，未经作者许可，不得用于其它商业用途，盗版必究。
************************************************************************************** */

#include "FsBSP_1602.h"
#include "FsBSP_Delay.h"


/* ***************************************************** */
// 函数名称：DectectBusyBit()
// 函数功能：液晶遇忙检测
// 入口参数：无
// 出口参数：无
/* ***************************************************** */
void DectectBusyBit(void)
{   
		DB = 0xff;				// 读状态值时，先赋高电平 
		RS = 0;
		RW = 1;					// 从液晶读数据
		EN = 1;
		DelayMS(1);
		while(DB & 0x80);		// 若LCD忙，停止到这里，否则走起
		EN = 0;					// 之后将EN初始化为低电平 
}
/* ***************************************************** */
// 函数名称：WrComLCD()
// 函数功能：向液晶写命令
// 入口参数：命令(ComVal)
// 出口参数：无
/* ***************************************************** */
void WrComLCD(uChar8 ComVal)
{
		DectectBusyBit();
		RS = 0;
		RW = 0;
		EN = 1;
		DB = ComVal;
		DelayMS(1);
		EN = 0;	
}
/* ***************************************************** */
// 函数名称：WrDatLCD()
// 函数功能：向液晶写数据
// 入口参数：数据(DatVal)
// 出口参数：无
/* ***************************************************** */
void WrDatLCD(uChar8 DatVal)
{
		DectectBusyBit();
		RS = 1;
		RW = 0;
		EN = 1;	
		DB = DatVal;
		DelayMS(1);
		EN = 0;	
}
/* ***************************************************** */
// 函数名称：LcdSetCursor(uChar8 x, uChar8 y)
// 函数功能：设置显示起始地址
// 入口参数：uChar8 x, uChar8 y，即光标的坐标位置
// 出口参数：无
/* ***************************************************** */
void LcdSetCursor(uChar8 x, uChar8 y)
{
		uChar8 addr;
		if(y == 0)
			addr = 0x00 + x;
		else
			addr = 0x40 + x;
		WrComLCD(addr | 0x80);
		DelayMS(1);
}
/* ***************************************************** */
// 函数名称：LcdShowStr(uChar8 x, uChar8 y, uChar8 *str)
// 函数功能：设置字符串的显示
// 入口参数：uChar8 x, uChar8 y（即光标的坐标位置）uChar8 *str是字符串指针
// 出口参数：无
/* ***************************************************** */
void LcdShowStr(uChar8 x, uChar8 y, uChar8 *str)
{
		LcdSetCursor(x, y);
		while(*str != '\0')
		{
			WrDatLCD(*str++); 
			DelayMS(1);
		}
}
/* ***************************************************** */
// 函数名称：LcdShowCn(uChar8 x, uChar8 y, uChar8 seat)
// 函数功能：设置汉字显示
// 入口参数：uChar8 x, uChar8 y（即光标的坐标位置）uChar8 seat是数据
// 出口参数：无
/* ***************************************************** */
void LcdShowCn(uChar8 x, uChar8 y, uChar8 seat)
{
		LcdSetCursor(x, y);
		WrDatLCD(seat);
		DelayMS(1);
}
/* ***************************************************** */
// 函数名称：InitLcdCn(uChar8 *str)
// 函数功能：将自定义字符串的数据写入CGRAM中
// 入口参数：*str是字符串指针
// 出口参数：无
/* ***************************************************** */
void InitLcdCn(uChar8 *str)
{
		uChar8 i;
		WrComLCD(0x40);
	 	for(i = 0;i<32;i++)  //连续写入自定义字符串数据
    {
      WrDatLCD(*str++);
			DelayMS(1);
    }
}
/* ***************************************************** */
// 函数名称：LCD_Init()
// 函数功能：液晶初始化
// 入口参数：无
// 出口参数：无
/* ***************************************************** */
void LCD_Init(void)
{ 
		WrComLCD(0x38);		// 16*2行显示、5*7点阵、8位数据接口
		DelayMS(5);  		// 稍作延时
		WrComLCD(0x38);    	// 重新设置一遍
		WrComLCD(0x01);    	// 显示清屏 
		WrComLCD(0x06);    	// 光标自增、画面不动  
		DelayMS(5);			// 稍作延时
		WrComLCD(0x0C);    	// 开显示、关光标并不闪烁
}

/* ***************************************************** */
// 函数名称：Dispaly_1602()
// 函数功能：1602的显示函数
// 入口参数：无
// 出口参数：无
/* ***************************************************** */
void Dispaly_1602(void)
{
    uChar8 str[] = "fsmcu.taobao.com";      //液晶第一行显示的字符串
		LCD_Init();                         //初始化液晶
		InitLcdCn(tab);                     //初始化汉字显示也就是操作CGRAM
		LcdShowStr(0, 0, str);                //设置显示地址和内容
		LcdShowStr(0,1,"2015-08-30  25`C");   //第二行显示时间和温度
		LcdShowCn(4, 1, 0);		 			 //显示  ‘年’
		LcdShowCn(7, 1, 1);		 			 //显示  ‘月’
		LcdShowCn(10, 1, 2);				 //显示  ‘日’
		LcdShowCn(14, 1, 3);	 			 //显示  ‘。c’
		while(1);		
}

/* *********************************** End of File *********************************** */