/* ****************************** 作者：残弈悟恩 *****************************************
 * 文件名称 : FsBSP_Timer.c
 * 文件描述 : 定时器和中断驱动程序
 * 硬件平台 ：飛天三號 FSST15实验板
 * 软件环境 ：Keil uVision5.13
 * 
 * 版本代号	: V1.0 	   					
 * 修改日期	: 2015-09-05
 * 技术论坛 ：电子工程师基地（http://www.ieebase.net）
 * 淘宝店铺 ：http://fsmcu.taobao.com
 
 * Copyright (C), 2014-2015, 兰州文轩电子科技有限公司
 
 * 仅供学习使用，未经作者许可，不得用于其它商业用途，盗版必究。
************************************************************************************** */

#include "FsBSP_Timer.h"
#include "FsBSP_LedScreen.h"

uChar8 nMode = 0;

/* ******************************************************************
* 函数名称：Tiemr0Init(void)
* 入口参数：无
* 出口参数：无
* 函数功能：初始化定时器 0并且定时1ms
****************************************************************** */
void Tiemr0Init(void)
{
	AUXR &= 0x7F;		//定时器时钟12T模式
	TMOD &= 0xF0;		//设置定时器模式
	TL0 = 0x66;			//设置定时初值
	TH0 = 0xFC;			//设置定时初值
	TF0 = 0;			//清除TF0标志
	TR0 = 1;			//定时器0开始计时
	ET0 = 1;			//开定时器中断
	EA = 1;				//开总中断
}
/* ******************************************************************
* 函数名称：InterruptTimer0() interrupt 1
* 入口参数：无
* 出口参数：无
* 函数功能：T0中断服务函数，用来刷新点阵的显示模式
****************************************************************** */
void Timer0Int(void) interrupt 1
{
	static unsigned char iShift = 0;				//移动时间计数变量
	TH0 = 0xFC;								//定时1MS
	TL0 = 0x66;
	iShift++;								//记1MS个数
	if(60 == iShift)						//移动时间为70MS移动一次
	{			
		iShift = 0; 				//移动时间计数变量清零
		nMode++;						//模式改变
	}
	switch(nMode)
	{
		case 0: Up_Move_Dis();		break;	   	//模式0右移
												
		case 2: Down_Move_Dis();	break;	   	//模式2左移										
	}
	if(3 == nMode) nMode = 0;		
}

/* *********************************** End of File *********************************** */
