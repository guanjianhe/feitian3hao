/* ****************************** 作者：残弈悟恩 *****************************************
 * 文件名称 : FsBSP_PWM.c
 * 文件描述 : PWM的驱动程序
 * 硬件平台 ：飛天三號 FSST15实验板
 * 软件环境 ：Keil uVision5.13
 * 
 * 版本代号	: V1.0 	   					
 * 修改日期	: 2015-07-11
 * 技术论坛 ：电子工程师基地（http://www.ieebase.net）
 * 淘宝店铺 ：http://fsmcu.taobao.com
 
 * Copyright (C), 2014-2015, 兰州文轩电子科技有限公司
 
 * 仅供学习使用，未经作者许可，不得用于其它商业用途，盗版必究。
************************************************************************************** */
#include "BSP_Include.h"
/* ****************************************************************************
 * 函数名称：PWM2_Init(void)
 * 入口参数：无
 * 出口参数：无
 * 函数功能：PWM2的初始化函数
**************************************************************************** */
void PWM2_Init(void)
{
		P_SW2 |= 0x80;                  //使能访问XSFR
		PWMCFG = 0x00;                  //配置PWM的输出初始电平为低电平
		PWMCKS = 0x00;                  //选择PWM的时钟为Fosc/1
		PWMC = CYCLE;                   //设置PWM周期
		PWM2T1 = 0x0000;                //设置PWM2第1次反转的PWM计数
		PWM2T2 = 0x0001;                //设置PWM2第2次反转的PWM计数
																		//占空比为(PWM2T2-PWM2T1)/PWMC
		PWM2CR = 0x00;                  //选择PWM2输出到P3.7,不使能PWM2中断
		PWMCR = 0x01;                   //使能PWM信号输出
		PWMCR |= 0x40;                  //使能PWM归零中断
		PWMCR |= 0x80;                  //使能PWM模块
		P_SW2 &= ~0x80;

}
/* ****************************************************************************
 * 函数名称：pwm_isr() interrupt 22 using 1
 * 入口参数：无
 * 出口参数：无
 * 函数功能：PWM的中断函数
**************************************************************************** */
void pwm_isr() interrupt 22 using 1
{
    static bit dir = 1;
    static int val = 0;
    
    if (PWMIF & 0x40)
    {
        PWMIF &= ~0x40;
        
        if (dir)
        {
            val++;
            if (val >= CYCLE) dir = 0;
        }
        else
        {
            val--;
            if (val <= 1) dir = 1;
        }
        P_SW2 |= 0x80;
        PWM2T2 = val;
        P_SW2 &= ~0x80;
    }
}